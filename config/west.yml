## config/west.yml
```yaml
# This file specifies the build dependencies for Github Action workflows and
# for local build environments. The workspace has three toplevel directories
# containing the user config, user modules and ZMK. Zephyr and its dependencies
# are namespaced under /zmk to keep the toplevel clean.
#
# ZMK-Workspace
# ├── config
# ├── modules (user modules)
# └── zmk
#     └── modules (Zephyr modules)
#
# To create a local build environment, clone this repository and then run the
# following commands from its toplevel directory:
#
# $ west init -l config
# $ west update
# $ west zephyr-export
#
---
manifest:
  remotes:
    - name: inorichi
      url-base: https://github.com/inorichi
    - name: petejohanson
      url-base: https://github.com/petejohanson
    - name: stlimtat
      url-base: https://github.com/stlimtat
    - name: upstream
      url-base: https://github.com/zmkfirmware
    - name: urob
      url-base: https://github.com/urob
    - name: zmkfirmware
      url-base: https://github.com/zmkfirmware

  projects:
    - name: zmk-helpers
      remote: urob
      revision: main
      path: modules/helpers
    - name: zmk-auto-layer
      remote: urob
      revision: main
      path: modules/auto-layer
    - name: zmk-tri-state
      remote: urob
      revision: main
      path: modules/tri-state

    # ZMK with Zephyr namespaced under /zmk. This requires that ZMK imports
    # Zephyr with a path other than `zephyr` (as in `going-modular`).
    - name: zmk
      remote: zmkfirmware
      revision: v0.3
      import: app/west.yml
    - name: zmk-pmw3610-driver
      remote: inorichi
      revision: main

  self:
    path: config
```
